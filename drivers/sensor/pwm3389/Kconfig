## drivers/sensor/pwm3389/Kconfig
```kconfig
# Copyright (c) 2021 Team Spatzenhirn
# SPDX-License-Identifier: Apache-2.0

config PWM3389
	bool "PWM3389 motion sensor"
	default y
	depends on DT_HAS_PIXART_PWM3389_ENABLED
	depends on SPI
	help
	  Enable PWM3389 motion sensor.
```

## dts/bindings/led_strip/worldsemi,ws2812-flexio.yaml
```yaml
description: |
  Worldsemi WS2812 LED strip, FlexIO binding

compatible: "worldsemi,ws2812-flexio"

include: [ base.yaml, ws2812.yaml ]

on-bus: flexio

properties:
  label:
    required: true

  timer:
    required: true
    type: int

  shifter:
    required: true
    type: int

  output-pin:
    required: true
    type: int
```

## dts/bindings/misc/nxp,flexio.yaml
```yaml
description: FlexIO peripheral

compatible: "nxp,flexio"

include: base.yaml

bus: flexio

properties:
  "#address-cells":
    required: true
    const: 1
  "#size-cells":
    required: true
    const: 0
  label:
    required: true
  clocks:
    required: true
```

## dts/bindings/sensor/pixart,pwm3389.yaml
```yaml
# Copyright (c) 2022 Team Spatzenhirn
# SPDX-License-Identifier: Apache-2.0


description: |
  Motion Sensor

compatible: "pixart,pmw3389"

include: spi-device.yaml
```

## dts/bindings/spi/nxp,flexio-spi.yaml
```yaml
description: NXP FlexIO SPI

compatible: "nxp,flexio-spi"

include: spi-controller.yaml


properties:
  reg:
    required: true

  clocks:
    required: true

  interrupts:
    required: true

  shifters:
    type: array
    required: true

  timers:
    type: array
    required: true

  sdo-pin:
    type: int
    required: true

  sdi-pin:
    type: int
    required: true

  sck-pin:
    type: int
    required: true

  csn-pin:
    type: int
    required: true
```
